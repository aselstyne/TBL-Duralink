#include <U8g2lib.h>
#include <math.h>

// Display pin mappings
#define WR_PIN 15  // Example pin number for WR (Enable)
#define CE_PIN 2  // Example pin number for CE (Chip Select)
#define CD_PIN 3  // Example pin number for C/D (Data/Command)
#define RESET_PIN 4  // Example pin number for Reset
// Initialize display
U8G2_T6963_240X128_F_8080 u8g2(U8G2_R0, /* data=*/ 5,6,7,8,9,10,11,12,  /* enable=*/ WR_PIN, /* cs=*/ CE_PIN, /* dc=*/ CD_PIN, /* reset=*/ RESET_PIN);

// Input pin mappings
const uint8_t DUR_PIN = A0;
const uint8_t CAT_PIN = A1;
const uint8_t ACETONE_PIN = A2;

// Output pin mappings
const uint8_t SOLENOID_PIN = 21;

//Display related constants
const uint8_t FRAME_RATE = 4; // Adjust frame rate, fps. Should be quite low to keep text readable.
static uint8_t centreOffset = 0; // Distance away from the center of each half for the text to be
static uint8_t error = 0;
unsigned long lastFrame = 0;
unsigned long avgCat = 0;
unsigned long avgDur = 0;
unsigned long avgAce = 0;
int numSamples = 0;


// Failsafe global vars
uint8_t bypassMode = 0; // 0 is bypass mode, 1 is spray mode, 2 is flush mode
bool pressureRecording = false;
unsigned long recStart = 0;
unsigned long lastV = -900000;
unsigned long lastRec = 0;
unsigned long engageTime = 0;
unsigned long bypassCooldownStart = 0;
unsigned long timeDelta = 0;
unsigned long error8Time = 60000; //Error 8 waits 1 minute before turning pump back on
unsigned long error7Time = 30000; // Error 7 waits 30 seconds before turning pump back on
// Circular queue like-structures which both record previous pressure values
const uint8_t REC_LEN = 50; // Number of previous values to store to make, one value is recorded every 100 ms
int catRecs[REC_LEN]; 
int durRecs[REC_LEN];
uint8_t numRecs = 0;
uint8_t head = 0;

// Bits for logo; you'll want to collapse these, typically.
const uint8_t tbldLogo_bits[] PROGMEM = {
    0x00, 0x00, 0x00, 0x00, 0x0F, 0x00, 0x00, 0x00, 0x00, 0x00, 0x00, 0x00, 
    0xC0, 0x3F, 0x00, 0x00, 0x00, 0x00, 0x00, 0x00, 0x00, 0xE0, 0x7F, 0x00, 
    0x00, 0x00, 0x00, 0x00, 0x00, 0x00, 0xF0, 0xFF, 0x00, 0x00, 0x00, 0x00, 
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    0x00, 0x00, 0x00, 0x00, 0x00, 0x00, 0x00, 0x0F, 0x00, 0x00, 0x00, 0x00, 
};

const uint8_t tbldText_bits[] PROGMEM = {
    0xFF, 0xFF, 0x03, 0x00, 0x7E, 0x00, 0x80, 0x1F, 0xFE, 0xFF, 0x07, 0x00, 
    0x80, 0x0F, 0x00, 0xFE, 0xFF, 0x07, 0x80, 0x1F, 0x00, 0x80, 0xFF, 0xFF, 
    0xFF, 0x0F, 0x80, 0xFF, 0x01, 0x00, 0xFF, 0xFF, 0x1F, 0x00, 0x7E, 0x00, 
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    0x80, 0xFF, 0xFF, 0x8F, 0xFF, 0xFF, 0xFF, 0x0F, 0x00, 0xFF, 0x01, 0x00, 
};

const uint8_t purgePin_bits[] PROGMEM = {
    0x00, 0x00, 0x00, 0xFC, 0x1F, 0x00, 0x00, 0x00, 0x00, 0x00, 0xC0, 0xFF, 
  0xFF, 0x01, 0x00, 0x00, 0x00, 0x00, 0xF8, 0xFF, 0xFF, 0x0F, 0x00, 0x00, 
  0x00, 0x00, 0xFE, 0xFF, 0xFF, 0x3F, 0x00, 0x00, 0x00, 0x80, 0xFF, 0xFF, 
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  0x00, 0x00, 0x00, 0x00, 0x00, 0x00, 0x00, 0x00,
};

// Bits for error page QR codes.
const uint8_t qr_debris[] PROGMEM = {
  0x00, 0x00, 0x00, 0x00, 0x00, 0x00, 0x00, 0x00, 0x00, 0x00, 0x00, 0x00, 
  0x00, 0x00, 0x00, 0x00, 0x00, 0x00, 0x00, 0x00, 0x00, 0x00, 0x00, 0x00, 
  0x00, 0x00, 0x00, 0x00, 0x00, 0x00, 0x00, 0x00, 0xF8, 0xFF, 0x01, 0x06, 
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  0x00, 0x00, 0x00, 0x00, 0x00, 0x00, 0x00, 0x00, 
};

const uint8_t qr_pressure[] PROGMEM = {
  0x00, 0x00, 0x00, 0x00, 0x00, 0x00, 0x00, 0x00, 0x00, 0x00, 0x00, 0x00, 
  0x00, 0x00, 0x00, 0x00, 0x00, 0x00, 0x00, 0x00, 0x00, 0x00, 0x00, 0x00, 
  0xF8, 0xFF, 0x81, 0x79, 0xE0, 0x9F, 0xFF, 0x1F, 0xF8, 0xFF, 0x81, 0x79, 
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  0x00, 0x00, 0x00, 0x00, 0x00, 0x00, 0x00, 0x00, 
};

const uint8_t qr_durflat[] PROGMEM = {
  0x00, 0x00, 0x00, 0x00, 0x00, 0x00, 0x00, 0x00, 0x00, 0x00, 0x00, 0x00, 
  0x00, 0x00, 0x00, 0x00, 0x00, 0x00, 0x00, 0x00, 0x00, 0x00, 0x00, 0x00, 
  0xF8, 0xFF, 0xE1, 0xFF, 0x9F, 0x99, 0xFF, 0x1F, 0xF8, 0xFF, 0xE1, 0xFF, 
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  0x00, 0x00, 0x00, 0x00, 0x00, 0x00, 0x00, 0x00, 
};

const uint8_t qr_catsupply[] PROGMEM = {
  0x00, 0x00, 0x00, 0x00, 0x00, 0x00, 0x00, 0x00, 0x00, 0x00, 0x00, 0x00, 
  0x00, 0x00, 0x00, 0x00, 0x00, 0x00, 0x00, 0x00, 0x00, 0x00, 0x00, 0x00, 
  0x00, 0x00, 0x00, 0x00, 0x00, 0x00, 0x00, 0x00, 0xF8, 0xFF, 0x01, 0xE6, 
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  0x00, 0x00, 0x00, 0x00, 0x00, 0x00, 0x00, 0x00, 
};



//Error messages for failsafes
static const char* messages[] = { // Max line width is approximately 31 characters.
  "Check purge valve on gun\nbefore spraying.", // "error" 1: check purge valve, in bypass mode
  "Catalyst pressure has dropped\nrepeatedly. Catalyst is likely\ncontaminated. Visit\nhelp.tbldurables.com/debris", // "warning" 2: there have been two V-shapes in one minute
  "Durables not pumping!\nBlocked durables gun hose.\nUse QR code or visit\nhelp.tbldurables.com/durflat", // "warning" 3: Catalyst pressure is low, and durables has flat lined
  "Catalyst overpressurization!\nDo not exceed 2300psi.\nBypass, then repressurize.\nhelp.tbldurables.com/pressure", //Error 4: overpressurization failsafe
  "Catalyst pressure too low!\nCat. must be pressurized\neven when flushing or\ncolor changing. Dump pressures.", // Error 5: BP mode, cat < 300, dur > 500
  "Catalyst pressure too high!\nCatalyst pressure should\nbe less than durables.\nBypass, then repressurize.", // Error 6: SP mode, cat>dur+200
  "Catalyst pressure unstable!\nPurge gun + dump pressures.\nUse QR code or visit\nhelp.tbldurables.com/catsupply", // Error 7: catalyst experiencing drastic swings, quick V's
  "Durables in acetone hose! Never\npull trigger if purge valve open.\nBypass and then PURGE GUN!" // Error 8: Acetone flow sensor
};

int getCatIndex(int index){
  // Get a logical index from the circular list
  // Passed in "index" 0 is the most recent recording, while the final index is the oldest
  return catRecs[(head - index + REC_LEN) % REC_LEN];
}

int getDurIndex(int index){
  return durRecs[(head - index + REC_LEN) % REC_LEN];
}

void insertVals(int catVal, int durVal){
  // Insert at position one more than head; mod at the end
  head = (head + 1) % REC_LEN;
  catRecs[head] = catVal;
  durRecs[head] = durVal;
  if (numRecs < REC_LEN){
    numRecs = numRecs + 1;
  }
}

void resetRecs(){
  // Resets all variables related to the circular queues
  // They are essentially empty after this is called.
  head = 0;
  numRecs = 0;
  recStart = 0;
}

void bypassUpdate(int cat, int dur) {
  // Update bypass mode status, according to current status and pressures
  if (bypassMode == 0){
    if (cat > 800 && dur > 1000){
      // Move out of bypass mode into spray mode
      // Clear the error when we do this, to stop displaying the purge valve thing
      error = 0;
      bypassMode = 1;
      resetRecs();
    }
  } else {
    if (cat < 300 && dur < 500){
      // 1 second cooldown on the failsafe. Must site below threshold for 1 second
      if (bypassCooldownStart == 0){
        bypassCooldownStart = millis();
      }
      timeDelta = millis() - engageTime; 
      if (((error != 7 && error != 8) || ((error == 7 && timeDelta > error7Time+2000) || (error == 8 && timeDelta > error8Time))) && (millis() - bypassCooldownStart > 1000)){
        if (error != 7) {
          error = 0; // Clear errors once pressure is dumped
        }
        bypassMode = 0;
        resetRecs();
      }
    } else {
      bypassCooldownStart = 0;
    }
  }
}

void errorEngage(){
  // Physically stop the machine from pumping if an error state is detected
  if (error > 3){ // "Errors" 1 to 3 are warning states; no shutoff required
    digitalWrite(SOLENOID_PIN, HIGH); // Turn the shutoff on
    // For error 7, we have to stop the error from immediately being cleared
    unsigned long timeDelta = millis() - engageTime;
    if ((error == 7 && timeDelta > error7Time) || (error == 8 && timeDelta > error8Time)){
      digitalWrite(SOLENOID_PIN, LOW);
    }
  } else
    digitalWrite(SOLENOID_PIN, LOW); // Turn solenoid off
}

void checkErrors(int cat, int dur) {
  unsigned long currTime = millis();
  //Check whether to engage the failsafes
  if (bypassMode == 0){
    // There is only two failsafes specific to bypass mode
    if (cat < 200 && dur > 500){
      // Wait 4 seconds before engaging
      if (recStart == 0)
        recStart = currTime;
      if (currTime - recStart > 4000)
        error = 5;
    } else {
      recStart = 0;
    }
    
    if (cat > 500 && cat < 1700)
      error = 1;
    else if (cat < 300 && dur < 300 && error != 7 && (error != 8 && timeDelta > error8Time))
      error = 0; // In bypass mode, we can just clear the error if neither of the conditions hold at a particular time
  } else if (bypassMode == 1) {
    // SPRAY MODE //
    //////// REGULAR SYSTEM FAILSAFES ///////////
    if (currTime-lastRec > 100){
      insertVals(cat,dur);
      // Get the minimum value for the catalyst in the recordings
      // And determine if all values were less than 700
      bool allLess = true;
      uint8_t catMinIndex = 0;
      int catMin = getCatIndex(0);
      for (int i = 0; i < numRecs; i++){
        if (getCatIndex(i) < catMin){
          catMin = getCatIndex(i);
          catMinIndex = i;
        }
        if (getCatIndex(i) > 500){
          allLess = false;
        }
      }

      // CHECK MAJOR SPRAY MODE ERRORS
      // Only check for new errors if there isn't already one set:
      if (error < 4){
        if (catMin<700) {
          // Search all indicies before min to find a max
          int preMax = 0;
          for (int i = numRecs-1; i > catMinIndex; i--){ //i > minindex because index 0 is current time,
            if (getCatIndex(i) > preMax)
              preMax = getCatIndex(i);
          }
          delay(50);
          // If current pressure is 300 above and so is pre max, then track a V
          if (cat > catMin + 300 && preMax > catMin + 300){
            if (currTime-lastV < 10000){
              engageTime = millis();
              resetRecs();
              lastV = -900000;
              error = 7; // Catalyst pressure fluctuating, likely caused by torn o-rings or obstructed bottom ball
            } else if (currTime-lastV < 90000) {
              error = 2; // WARNING, no shut down, catalyst likely contains debris, catalyst pressure fluctuating, and uncurred wet spots are likely.
            }
            lastV = currTime;
            resetRecs();
          }
        }
        // CHECK 2 and 3 - is catalyst all below 500?
        if (allLess){
          // allow data to gather for 3 seconds, with 1 second buffer
          if (recStart == 0){
            recStart = currTime;
          } else if (currTime-recStart > 4000) {
            // Determine max and min durables values
            int max = 0;
            int min = 5000;
            for (int i = 0; i < numRecs; i++){
              if (getDurIndex(i) > max)
                max = getDurIndex(i);
              if (getDurIndex(i) < min)
                min = getDurIndex(i);
            }
            // If the pressure varies by more than 50, then we're doing a flush
            if ((max-min) > 50 && error != 3){ // Ensure we haven't already seen a hose blockage
              recStart = 0;
              bypassMode = 2; // MOVE TO FLUSH MODE
            } else 
              if (cat<300){
                recStart=0;
                error = 3; // WARNING: blockage in check valve.
              }
          }
        }
      }
    } 
  }

  // Agnostic error
  if (cat>dur+800 && dur>600 && error < 4){
    error = 6; //catalyst is pressurized higher than durables
  }

  // Overpressurization is the most important error, and is always checked
  // Checked last as it takes precedent over all other errors
  if (cat > 2300 || (error == 4 && cat > 2000))
    error = 4;

}

int getRandPressure() {
  //Generates random pressure values, for testing
  int read = random(150, 160);
  return read*10;
}

int readPressure(uint8_t Apin) {
  // Reads pressure from the provided pin; A0 for durables, and A1 for Catalyst
  int sensorValue = analogRead(Apin);
  // Print the value to the serial monitor
  //Serial.println(sensorValue);

  // Map the sensor voltage value to the real pressure, using derived function
  if (sensorValue > 40){
    //See function: https://www.desmos.com/calculator/up0ncw2ma8
    return (5.57620817844)*(sensorValue-17);
  } else {
    return 0;
  }
}

void drawMultiLine(int y, int lineHeight, char* str){
  // Print a multi-line string on the screen
  // Split text into lines by newline character and print each line
  const char* line = str;
  char* text;
  int x;
  while (*line) {
    const char* nextLinePos = strchr(line, '\n');
    if (nextLinePos) {
      text = line;//String(line).substring(0, 3).c_str(); // Extact text
      x = (120 - u8g2.getStrWidth(text)/2); // Centre text
      u8g2.drawStr(x, y, text);
      line = nextLinePos + 1;  // Move to the next line
    } else {
      x = (120 - u8g2.getStrWidth(line)/2); // Centre text
      u8g2.drawStr(x, y, line);  // Draw the final line
      break;
    }
    y += lineHeight;  // Move to the next line position
  }
}



// SCRIPT
void setup() {
  // Pin setup
  pinMode(SOLENOID_PIN, OUTPUT);
  pinMode(ACETONE_PIN, INPUT);

  // Start up libraries
  u8g2.begin();
  Serial.begin(9600);
  Serial.println("TBLD Link - V1.1.0");

  // Display boot screen for 5 secs
  u8g2.firstPage();
  do {
    u8g2.drawXBMP(3, 82, 233, 38, tbldText_bits);
    u8g2.drawXBMP(86, 4, 68, 68, tbldLogo_bits);
  } while (u8g2.nextPage());
  
  delay(5000);
}



/// GENERAL DISPLAY LOOP ///
void loop() {
  // Before UI, poll pressures.
  int catPress = readPressure(CAT_PIN);
  int durPress = readPressure(DUR_PIN);
  int acetoneValue = analogRead(ACETONE_PIN);
  avgCat = avgCat + catPress;
  avgDur = avgDur + durPress;
  avgAce = avgAce + acetoneValue;
  numSamples = numSamples + 1;

  Serial.println("P" + String(acetoneValue));
  
  // Engage Acetone Failsafe
  if (acetoneValue > 850){
    engageTime = millis();
    error = 8;
  }

  // Run Cat/Dur Failsafes
  bypassUpdate(catPress, durPress); // Update status into/out of bypass mode; clear error when moving into
  // Failsafe checks + display
  // This is checked and displayed first, so that the pressures move out of the way
  //checkErrors(catPress, durPress);
  // Engage failsafes, if necessary
  errorEngage();


  // Check that enough time has passed to display a frame on screen:
  if (millis()-lastFrame >= 1000/FRAME_RATE){
    lastFrame = millis();
    // Display the average values for both the pressures since the last frame, rounded to the nearest 25 psi.
    avgCat = round(avgCat/numSamples / 25.0) * 25;
    avgDur = round(avgDur/numSamples / 25.0) * 25;
    avgAce = round(avgAce/numSamples);
    String catPressString = String(avgCat);
    String durPressString = String(avgDur);
    const char* catPressStr = catPressString.c_str();
    const char* durPressStr = durPressString.c_str();

    // Output reading from acetone transducer
   // Serial.println("A" + String(avgAce));
    
    //Start paging for UI Display
    u8g2.firstPage();
    do {
      //Display failsafes
      if (error) {
        centreOffset = 20;
        // Failsafe prints
        u8g2.setFont(u8g2_font_fur11_tr);
        drawMultiLine(80, 13, messages[error-1]);
        // Add the countdown line
        if (error == 8){
          timeDelta = millis() - engageTime; 
          unsigned long remaining = (error8Time-timeDelta)/1000;
          char temp[50];  // Make sure the buffer is large enough
          if (remaining < 1000){
            snprintf(temp, sizeof(temp), "Pump will restart in %lu seconds.", remaining);
          } else {
            snprintf(temp, sizeof(temp), "You can now pressurize");
          }
          u8g2.drawStr(12, 120, temp);  // Draw the final line
        }

        // Print Graphics
        int centre = (120 - 32);
        if (error == 1) {
          u8g2.drawXBMP(centre, 2, 64, 64, purgePin_bits);
        } else if (error == 2) {
          u8g2.drawXBMP(centre, 2, 64, 64, qr_debris);
        } else if (error == 3) {
          u8g2.drawXBMP(centre, 2, 64, 64, qr_durflat);
        } else if (error == 4) {
          u8g2.drawXBMP(centre, 2, 64, 64, qr_pressure);
        } else if (error == 7) {
          u8g2.drawXBMP(centre, 2, 64, 64, qr_catsupply);
        } else {
          u8g2.setFont(u8g2_font_open_iconic_check_8x_t);  // Set the font to the symbol font
          u8g2.drawGlyph(centre, 66, 66);
        }
      } else {
        // No offset from centre
        centreOffset = 0;
        u8g2.setFont(u8g2_font_6x10_tr);
        // Display psi labels
        u8g2.drawStr(100, 30, "psi");
        u8g2.drawStr(220, 30, "psi");
      }

      // Set the font to a sans-serif style
      u8g2.setFont(u8g2_font_fur11_tr);
      
      // Label text for each half
      const char* leftText = "Catalyst";
      const char* rightText = "Durables";
      
      // Calculate positions for centering text
      int leftX = (120 - u8g2.getStrWidth(leftText)) / 2 - centreOffset;
      int rightX = 120 + (120 - u8g2.getStrWidth(rightText)) / 2 + centreOffset;

      // If flushing detected, tell the user that
      if (bypassMode == 2){
        const char* flush = "FLUSH MODE ON";
        u8g2.drawStr(120 - u8g2.getStrWidth(flush)/2, 80, flush);
        const char* warning = "If not flushing/color changing,\n dump and repressurize.\nIf you're flushing, ignore warning.";
        drawMultiLine(95, 13, warning);
      }
      
      // Draw the text in each half
      u8g2.drawStr(leftX, 50, leftText);  // Centered on the left half
      u8g2.drawStr(rightX, 50, rightText);  // Centered on the right half


      // Draw the pressures
      u8g2.setFont(u8g2_font_fur25_tn);
      leftX = (120 - u8g2.getStrWidth(catPressStr)) / 2 - centreOffset;
      rightX = 120 + (120 - u8g2.getStrWidth(durPressStr)) / 2 + centreOffset;
      u8g2.drawStr(leftX, 30, catPressStr);
      u8g2.drawStr(rightX, 30, durPressStr);
    } while (u8g2.nextPage());
    // Reset averages
    avgCat = 0;
    avgDur = 0;
    avgAce = 0;
    numSamples = 0;
  }
}
